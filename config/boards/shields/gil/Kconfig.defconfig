## config/boards/shields/gil/Kconfig.defconfig
```kconfig
if SHIELD_GIL_LEFT
config ZMK_KEYBOARD_NAME
    default "Gil"
config ZMK_SPLIT_ROLE_CENTRAL
    default y
endif

if SHIELD_GIL_LEFT || SHIELD_GIL_RIGHT
config ZMK_SPLIT
    default y
endif
```

## config/boards/shields/gil/Kconfig.shield
```kconfig
config SHIELD_GIL_LEFT
    def_bool $(shields_list_contains,gil_left)

config SHIELD_GIL_RIGHT
    def_bool $(shields_list_contains,gil_right)
```
